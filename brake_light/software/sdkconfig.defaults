## brake_light/software/sdkconfig.defaults
```kconfig
# Default sdkconfig values applied on a fresh build (committed; the generated
# `sdkconfig` is not). Override per-board with `idf.py menuconfig`.
#
# Target-specific values live in sibling sdkconfig.defaults.<target> files that
# IDF applies automatically on top of this one for the selected target:
#   - sdkconfig.defaults.esp32c3   product target — USB Serial/JTAG console
#   - sdkconfig.defaults.esp32     interim dev hardware — UART console
# Pick the target with `idf.py set-target esp32c3` / `esp32` (or the CI matrix).

# Smaller, quieter default log level for shipping firmware.
CONFIG_LOG_DEFAULT_LEVEL_INFO=y
```

## brake_light/software/sdkconfig.defaults.esp32
```kconfig
# Classic ESP32 (interim dev hardware) — applied on top of sdkconfig.defaults
# when the target is esp32.
#
# The classic ESP32 has no USB peripheral, so the console (REPL + logs) runs over
# UART0 (GPIO1 TX / GPIO3 RX) through the board's onboard USB-UART bridge. This
# is already the IDF default for esp32; set explicitly for parity with the C3
# defaults file and to document the divergence.
CONFIG_ESP_CONSOLE_UART_DEFAULT=y
```

## brake_light/software/sdkconfig.defaults.esp32c3
```kconfig
# ESP32-C3 (product target) — applied on top of sdkconfig.defaults when the
# target is esp32c3.
#
# Route the console (REPL + logs) to the built-in USB Serial/JTAG controller: an
# enumerated virtual COM port over the native USB pins (GPIO18/GPIO19) that also
# carries JTAG debugging on the same cable — no external USB-TTL adapter needed.
CONFIG_ESP_CONSOLE_USB_SERIAL_JTAG=y
```
